KNUMBS		EQU		06A2H
GETL		EQU		06A4H
LETLN		EQU		0A2EH
MSGPR		EQU		0889H
GETKEY		EQU		0832H
BREAK		EQU		0562H
PRTBYT		EQU		05F3H
PRNT		EQU		08C6H
DISPCH		EQU		08C6H
DPCT		EQU		08C6H
IBUFE		EQU		1140H
FNAME		EQU		1141H
EADRS		EQU		1152H
FSIZE		EQU		1152H
SADRS		EQU		1154H
EXEAD		EQU		1156H
DSPX		EQU		11D1H
MONITOR		EQU		00B1H
;MZ-80B SB-1520用
LBUF		EQU		1093H
MBUF		EQU		109DH
;MZ-2000 MZ-1Z001M用
;LBUF		EQU		10ABH
;MBUF		EQU		10B6H


;0A0H PORTA 送信データ(下位4ビット)
;0A1H PORTB 受信データ(8ビット)
;
;0A2H PORTC Bit
;7 IN  CHK
;6 IN
;5 IN
;4 IN 
;3 OUT
;2 OUT FLG
;1 OUT
;0 OUT
;
;0A3H コントロールレジスタ


        ORG		1200H

FSIZE2		DS		2
SADRS2		DS		2
EXEAD2		DS		2

SDLOAD:
;START ADRESSが0000Hでないならスタックポインタを1140Hに戻す。
		LD		HL,SADRS2
		LD		A,(HL)
		INC		HL
		OR		(HL)
		JR		Z,SDLD1
		LD		SP,1140H
SDLD1:	
		CALL	DBRCV      ;データ受信
		LD		HL,(EXEAD2)
		JP		(HL)

;データ受信
DBRCV:	LD		DE,(FSIZE2)
		LD		HL,(SADRS2)
DBRLOP:	CALL	RCVBYTE
		LD		(HL),A
		DEC		DE
		LD		A,D
		OR		E
		INC		HL
		JR		NZ,DBRLOP   ;DE=0までLOOP
		RET


;**** 1BYTE受信 ****
;受信DATAをAレジスタにセットしてリターン
RCVBYTE:
		CALL	F1CHK      ;PORTC BIT7が1になるまでLOOP
		IN		A,(0A1H)   ;PORTB -> A
		PUSH 	AF
		LD		A,05H
		OUT		(0A3H),A    ;PORTC BIT2 <- 1
		CALL	F2CHK      ;PORTC BIT7が0になるまでLOOP
		LD		A,04H
		OUT		(0A3H),A    ;PORTC BIT2 <- 0
		POP 	AF
		RET
		
;**** BUSYをCHECK(1) ****
; 82H BIT7が1になるまでLOP
F1CHK:	IN		A,(0A2H)
		AND		80H        ;PORTC BIT7 = 1?
		JR		Z,F1CHK
		RET

;**** BUSYをCHECK(0) ****
; 82H BIT7が0になるまでLOOP
F2CHK:	IN		A,(0A2H)
		AND		80H        ;PORTC BIT7 = 0?
		JR		NZ,F2CHK
		RET

		END
